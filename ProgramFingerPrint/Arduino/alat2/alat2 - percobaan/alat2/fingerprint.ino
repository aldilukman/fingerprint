void setupFingerPrint()
{

  // set the data rate for the sensor serial port
  finger.begin(57600);

  if (finger.verifyPassword()) {
    Serial.println("P1_Found Sensor_");
  } else {
    Serial.println("P1_Not Found Sensor_");
    while (1) {
      delay(1);
    }
  }
}
void enroll(int idNumber)                     // run over and over again
{
  while (!  getFingerprintEnroll(idNumber) );
}

uint8_t getFingerprintEnroll(int id) {

  int p = -1;
  Serial.println("P1_Register_");
  Serial.println("P_Insert Finger_");
  while (p != FINGERPRINT_OK) {
    p = finger.getImage();
    switch (p) {
      case FINGERPRINT_OK:
        Serial.println("P_Image taken_");
        break;
      case FINGERPRINT_NOFINGER:
        //Serial.println("P_No Finger_");
        break;
      default:
        Serial.println("P_Failed Read_");
        break;
    }
  }

  // OK success!

  p = finger.image2Tz(1);
  switch (p) {
    case FINGERPRINT_OK:
      Serial.println("P_Image converted_");
      break;

    default:
      Serial.println("P_Failed Read_");
      return p;
  }

  Serial.println("P_Remove finger_");
  delay(2000);
  p = 0;
  while (p != FINGERPRINT_NOFINGER) {
    p = finger.getImage();
  }
  p = -1;
  Serial.println("P_Insert Finger_");
  while (p != FINGERPRINT_OK) {
    p = finger.getImage();
    switch (p) {
      case FINGERPRINT_OK:
        Serial.println("P_Image taken_");
        break;
      case FINGERPRINT_NOFINGER:
        //Serial.println("P_Place finger_");
        break;

      default:
        Serial.println("P_Failed read_");
        break;
    }
  }

  // OK success!

  p = finger.image2Tz(2);
  switch (p) {
    case FINGERPRINT_OK:
      Serial.println("P_Image converted_");
      break;
    default:
      Serial.println("P_Failed Read_");
      return p;
  }

  // OK converted!
  Serial.println("P_Creating_");

  p = finger.createModel();
  if (p == FINGERPRINT_OK) {
    Serial.println("P_Prints matched_");
  }
  else {
    Serial.println("P_Prints not matched_");
    return p;
  }

  p = finger.storeModel(id);
  if (p == FINGERPRINT_OK) {
    Serial.println("P_Stored_");
    Serial.println("S_Sukses");
    downloadFingerprintTemplate(id);
  }
  else {
    Serial.println("P_Error writing_");
    return p;
  }
}

uint8_t getFingerprintID() {
  uint8_t p = finger.getImage();
  switch (p) {
    case FINGERPRINT_OK:
      Serial.println("P1_Checking Data_");
      break;
    default:
      //Serial.println("P_Failed Read_");
      return p;
  }

  // OK success!

  p = finger.image2Tz();
  switch (p) {
    case FINGERPRINT_OK:
      Serial.println("P_Image converted_");
      break;

    default:
      Serial.println("P_Failed Read_");
      return p;
  }

  // OK converted!
  p = finger.fingerFastSearch();
  if (p == FINGERPRINT_OK) {
    Serial.println("P_Found a print match_");
    Serial.println("B3_");
  } else if (p == FINGERPRINT_NOTFOUND) {
    Serial.println("P_FF Not Found_");
    Serial.println("N_NotFound_");
    Serial.println("B3_");
    delay(1000);
    Serial.println("B3_");
    delay(1000);
    Serial.println("B3_");
    delay(1000);
    return p;
  } else {
    //Serial.println("P_Failed");
    return p;
  }

  // found a match!
  Serial.print("P_Found ID #");
  Serial.print(finger.fingerID);
  Serial.println("_");
  Serial.print("M_");
  Serial.println(finger.fingerID);
  Serial.println("B3_");
  return finger.fingerID;
}

void deleteFingerprint(int id) {
  uint8_t p = -1;
  Serial.println("P1_Delete User_");
  Serial.print("P_#");
  Serial.println(id);
  p = finger.deleteModel(id);

  if (p == FINGERPRINT_OK) {
    Serial.print("P_Delete ");
    Serial.print(id);
    Serial.println("_");
    Serial.println("S_Sukses");
  } else {
    Serial.println("P_Failed Delete_");
  }
}

void emptyData() {
  finger.emptyDatabase();
  Serial.println("P1_Deleted All Data_");
  Serial.println("S_Sukses");
}

uint8_t downloadFingerprintTemplate(uint16_t id)
{
  Serial.print("Attempting to load #"); Serial.println(id);
  int p = finger.loadModel(id);
  switch (p) {
    case FINGERPRINT_OK:
      Serial.print("Template "); Serial.print(id); Serial.println(" loaded");
      break;
    case FINGERPRINT_PACKETRECIEVEERR:
      Serial.println("Communication error");
      return p;
    default:
      Serial.print("Unknown error "); Serial.println(p);
      return p;
  }

  Serial.print("Attempting to get #"); Serial.println(id);
  p = finger.getModel();       // FP_UPLOAD = UPCHAR 0x08  -getModel() for Char Buffer 1 and getM odel2() for Char Buffer 2-
  switch (p) {
    case FINGERPRINT_OK:
      Serial.print("Template "); Serial.print(id); Serial.println(" transferring:");
      break;
    default:
      Serial.print("Unknown error "); Serial.println(p);
      return p;
  }

  uint8_t bytesReceived[900];

  int i = 0;
  while (i <= 900 ) {
    if (Serial3.available()) {
      bytesReceived[i++] = Serial3.read();
    }
  }
  i = 0;
  EthernetClient client;
  if (client.connect(IPAddress(192, 168, 1, 7), 12345))
  {
    while (i <= 900 ) {
      client.write(bytesReceived[i++]);
    }
    client.stop();
  }
  
  Serial.println("Decoding packet...");

  // Filtering The Packet
  int a = 0, x = 3;
  Serial.print("uint8_t packet2[] = {");
  for (int i = 10; i <= 832; ++i) {
    a++;
    if (a >= 129)
    {
      i += 10;
      a = 0;
      Serial.println("};"); Serial.print("uint8_t packet"); Serial.print(x); Serial.print("[] = {");
      x++;
    }
    else
    {
      Serial.print("0x"); printHex(bytesReceived[i - 1] , 2); Serial.print(", "); //Serial.print("/");
    }
  }
  Serial.println("};");
  Serial.println("COMPLETED\n");
  
}



void printHex(int num, int precision) {
  char tmp[16];
  char format[128];

  sprintf(format, "%%.%dX", precision);

  sprintf(tmp, format, num);
  Serial.print(tmp);
}
void uploadFingerPrint(int id) {
  uint8_t packet2[] = {0x03, 0x03, 0x5A, 0x2A, 0x28, 0x01, 0x3F, 0x01, 0x7B, 0x00, 0x00, 0x00, 0x00,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 0x01, 0x01};
  uint8_t packet3[] = {0x2C, 0x8C, 0xD4, 0xBE, 0x3A, 0x14, 0x15, 0x3E, 0x76, 0x9A, 0xDA, 0xFE, 0x42,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 0x41, 0xF8};
  uint8_t packet4[] = {0x6C, 0x16, 0xC3, 0xD9, 0x60, 0xC8, 0xC3, 0xF9, 0x5C, 0x4A, 0x86, 0x39, 0x4E,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 0x00, 0x00};
  uint8_t packet5[] = {0x03, 0x03, 0x5C, 0x2F, 0x00, 0x01, 0x20, 0x01, 0x7C, 0x00, 0x00, 0x00, 0x00,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 0x00, 0x00};
  uint8_t packet6[] = {0x23, 0x84, 0x56, 0x1E, 0x54, 0x05, 0x99, 0x5E, 0x1B, 0x0A, 0x14, 0xBE, 0x66,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 0xD6, 0xBD};
  uint8_t packet7[] = {0x53, 0xAE, 0xD7, 0xFD, 0x54, 0xB1, 0xD7, 0x1D, 0x0C, 0x37, 0x4D, 0x7D, 0x58,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 0x00, 0x00};

  Serial.print("\n===> Write Packet");
  int p = finger.uploadModelDY50(packet2, packet3, packet4, packet5, packet6, packet7);    // Simpan di Char Buffer 01
  switch (p) {
    case FINGERPRINT_OK:
      Serial.println(" SUKSES");
      Serial.read();
      break;
    case FINGERPRINT_PACKETRECIEVEERR:
      Serial.println("Communication error");
      return p;
    case FINGERPRINT_BADPACKET:
      Serial.println("Bad packet");
      return p;
    default:
      {
        Serial.println("\n==>[SUKSES] UploadModel = ");
        //return p;
      }
  }
  Serial.print("\n==>[SUKSES] StoreModel + ID = "); Serial.print(id);
  p = finger.storeModel(id);                  // taruh di ID = 0 pada flash memory FP
  if (p == FINGERPRINT_OK) {
    Serial.println(" Stored!");
  } else if (p == FINGERPRINT_PACKETRECIEVEERR) {
    Serial.println("Communication error");
    return p;
  } else if (p == FINGERPRINT_BADLOCATION) {
    Serial.println("Could not store in that location");
    return p;
  } else if (p == FINGERPRINT_FLASHERR) {
    Serial.println("Error writing to flash");
    return p;
  } else {
    Serial.println("Unknown error");
    return p;
  }
}
